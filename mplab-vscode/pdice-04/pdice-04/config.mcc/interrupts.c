// Code generated by MCHP Chatbot
#include "mcc_generated_files/system/system.h"
#include "utils.h"
//#include "tones.h"
#include "interrupts.h"


// IOC on falling edge
volatile enum _sw_status sw_status;
void Switch_Interrupt_Callback(void)
{
    // Update switch status flag    
    sw_status = PRESSED;

    // Reset the power-off timer by restarting Timer2
    run_state = ACTIVE;
    Timer2_CountCallBack = 0;
}

// Timer1 callback function. This will increment ms_ticks every millisecond.
void Timer1_Tick_Callback(void)
{
    ms_ticks++;
}


// Timer2 callback function. 
// We get here every 65.536ms, so for a 5 minute timeout, count to 5*60/0.065536 = 4578
volatile enum _run_state run_state;
volatile uint16_t Timer2_CountCallBack = 0;
void Timer2_Period_Callback(void)
{ 
    // Only shutdown when we were in Active mode since the processor doesn't remember the state after waking up. 
    // If we shutdown in INTRO mode, we wake up in Active with '1' showing, and that should not happen. 
    if( ++Timer2_CountCallBack >= TMR2_TIMEOUT_COUNT)
    {
        if (run_state == ACTIVE) {
            run_state = SHUTDOWN;
        }
        if (run_state == INTRO) {
            run_state = SHUTDOWN_INTRO;
        }
        Timer2_CountCallBack = 0;
    }
}
